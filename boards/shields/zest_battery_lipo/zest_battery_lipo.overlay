/*
 * Copyright (c) 2024, CATIE
 * SPDX-License-Identifier: Apache-2.0
 */

#include <zephyr/dt-bindings/gpio/sixtron-header.h>

#define PERIPHERAL_ZEST_BATTERY_LIPO(port) \
	i2c_zest_battery_lipo_##port: &sixtron_connector_##port##_i2c {};

#define DRIVERS_ZEST_BATTERY_LIPO(port) \
	&i2c_zest_battery_lipo_##port { \
		status = "okay"; \
		max17201_zest_battery_lipo_##port: max17201##port@36 { \
			compatible = "maxim,max17201"; \
			reg = <0x36>; \
			sbs = <0x0b>; \
			nb-cell = <1>; \
			rshunt = <20>; \
			capacity = <800>; \
			empty-voltage = <3050>; \
			voltage-thresholds = <3600 4250>; \
			current-thresholds = <(-800) 800>; \
			temperature-thresholds = <2732 3181>; \
			external-thermistor1; \
			external-thermistor2; \
			alert-gpios = <&sixtron_connector DIO1 (GPIO_ACTIVE_LOW)>; \
		}; \
	};

#define ZEST_BATTERY_LIPO(port) \
	PERIPHERAL_ZEST_BATTERY_LIPO(port) \
	DRIVERS_ZEST_BATTERY_LIPO(port)
